## source/test-firmware/main/Kconfig.projbuild
```kconfig
menu "LiteJam firmware identity"

config LITEJAM_HARDWARE_PROFILE_ID
    string "Stable hardware profile ID"
    default "unconfigured-hardware"

config LITEJAM_FIRMWARE_ID
    string "Stable firmware lineage ID"
    default "unconfigured-firmware"

config LITEJAM_FORCE_ROLLBACK_TEST
    bool "Force an OTA rollback after boot (test images only)"
    default n
    help
        Never enable this for a production image. It deliberately reboots an
        OTA image while it is pending verification so the bootloader must fall
        back to the previously validated slot.

endmenu
```

## source/test-firmware/profiles/esp32s3-16m-v1/sdkconfig.defaults
```kconfig
CONFIG_IDF_TARGET="esp32s3"
CONFIG_COMPILER_OPTIMIZATION_SIZE=y
CONFIG_ESPTOOLPY_FLASHSIZE_16MB=y
CONFIG_ESPTOOLPY_FLASHMODE_DIO=y
CONFIG_ESPTOOLPY_FLASHFREQ_40M=y
CONFIG_PARTITION_TABLE_CUSTOM=y
CONFIG_PARTITION_TABLE_CUSTOM_FILENAME="profiles/esp32s3-16m-v1/partitions.csv"
CONFIG_LITEJAM_HARDWARE_PROFILE_ID="esp32s3-16m-v1"
CONFIG_LITEJAM_FIRMWARE_ID="guitar-rgba1-esp32s3"

CONFIG_BT_ENABLED=y
CONFIG_BT_NIMBLE_ENABLED=y
CONFIG_BT_BLUEDROID_ENABLED=n
CONFIG_BT_NIMBLE_ATT_PREFERRED_MTU=517
CONFIG_BT_NIMBLE_GAP_SERVICE=y
# RSA-3072 OTA verification runs inside the NimBLE host callback and needs more
# than the ESP-IDF default 4096-byte stack.
CONFIG_BT_NIMBLE_HOST_TASK_STACK_SIZE=8192

CONFIG_BOOTLOADER_APP_ROLLBACK_ENABLE=y
CONFIG_SECURE_SIGNED_APPS_NO_SECURE_BOOT=y
CONFIG_SECURE_SIGNED_ON_UPDATE_NO_SECURE_BOOT=y
CONFIG_SECURE_SIGNED_APPS_RSA_SCHEME=y
CONFIG_SECURE_BOOT_SIGNING_KEY="keys/ota_test_signing_key_s3_rsa3072.pem"

CONFIG_ESP_COREDUMP_ENABLE_TO_FLASH=y
CONFIG_LOG_DEFAULT_LEVEL_INFO=y
```

## source/test-firmware/sdkconfig.defaults
```kconfig
CONFIG_IDF_TARGET="esp32"
CONFIG_COMPILER_OPTIMIZATION_SIZE=y
CONFIG_ESPTOOLPY_FLASHSIZE_4MB=y
CONFIG_PARTITION_TABLE_CUSTOM=y
CONFIG_PARTITION_TABLE_CUSTOM_FILENAME="partitions.csv"

CONFIG_BT_ENABLED=y
CONFIG_BT_NIMBLE_ENABLED=y
CONFIG_BT_BLUEDROID_ENABLED=n
CONFIG_BT_NIMBLE_ATT_PREFERRED_MTU=517
CONFIG_BT_NIMBLE_GAP_SERVICE=y

CONFIG_BOOTLOADER_APP_ROLLBACK_ENABLE=y
CONFIG_SECURE_SIGNED_APPS_NO_SECURE_BOOT=y
CONFIG_SECURE_SIGNED_ON_UPDATE_NO_SECURE_BOOT=y
CONFIG_SECURE_SIGNED_APPS_ECDSA_SCHEME=y
CONFIG_SECURE_BOOT_SIGNING_KEY="keys/ota_test_signing_key.pem"

CONFIG_LOG_DEFAULT_LEVEL_INFO=y
```
